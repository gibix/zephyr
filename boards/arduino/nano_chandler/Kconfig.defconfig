## boards/arduino/nano_rp2040_connect/Kconfig.arduino_nano_rp2040_connect
```kconfig
# Copyright (c) 2026 ARDUINO SRL
# SPDX-License-Identifier: Apache-2.0

config BOARD_ARDUINO_NANO_RP2040_CONNECT
	select SOC_RP2040
```

## boards/arduino/nano_rp2040_connect/Kconfig.defconfig
```kconfig
# Copyright (c) 2026 ARDUINO SRL
# SPDX-License-Identifier: Apache-2.0

if BOARD_ARDUINO_NANO_RP2040_CONNECT

if I2C_DW

config I2C_DW_CLOCK_SPEED
	default 125

endif # I2C_DW

config USB_SELF_POWERED
	default n

endif # BOARD_ARDUINO_NANO_RP2040_CONNECT
```

## drivers/otp/Kconfig.mchp
```kconfig
# Copyright (c) 2026 Arduino SA
# SPDX-License-Identifier: Apache-2.0

config OTP_MCHP_FUSES
	bool "Microchip PIC32CK calibration/OTP fuse row driver"
	default y
	depends on DT_HAS_MICROCHIP_PIC32CK_FUSES_ENABLED
	help
	  Enable read access to the calibration/OTP fuse row (FUSES_CALOTP) of
	  Microchip PIC32CK SG/GC SoCs.

	  The row is provisioned during manufacturing, so the "program"
	  operation is not supported.
```

## dts/bindings/otp/microchip,pic32ck-fuses.yaml
```yaml
# Copyright (c) 2026 Arduino SA
# SPDX-License-Identifier: Apache-2.0

title: Microchip PIC32CK calibration/OTP fuse row

description: |
  Read-only, memory-mapped fuse row (FUSES_CALOTP) of PIC32CK SG/GC SoCs,
  holding factory-programmed data such as peripheral trim values and the
  Ethernet MAC address. See the "Fuses" section of the family data sheet for
  the layout.

compatible: "microchip,pic32ck-fuses"

include: base.yaml

properties:
  reg:
    required: true
    description: Start address and size of the fuse row.
```
